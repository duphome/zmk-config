/*
 * Copyright (c) 2020 Ryan Cross
 *
 * SPDX-License-Identifier: MIT
 */

#include "sofle.dtsi"

&default_transform {
    col-offset = <6>;
};

&kscan0 {
    col-gpios
        = <&pro_micro 0 10 GPIO_ACTIVE_HIGH>
        , <&pro_micro 0 16 GPIO_ACTIVE_HIGH>
        , <&pro_micro 0 14 GPIO_ACTIVE_HIGH>
        , <&pro_micro 0 14 GPIO_ACTIVE_HIGH>
        , <&pro_micro 0 18 GPIO_ACTIVE_HIGH>
        , <&pro_micro 0 19 GPIO_ACTIVE_HIGH>
        ;
};

&right_encoder {
    status = "okay";
};
